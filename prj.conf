## CMakeLists.txt
```
cmake_minimum_required(VERSION 3.18.0)

set(CMAKE_CXX_STANDARD 17)
set(CMAKE_CXX_STANDARD_REQUIRED ON)

find_package(Zephyr REQUIRED HINTS $ENV{ZEPHYR_BASE})
project(embedded_hal_project)

target_sources(app PRIVATE
    src/main.cpp
    src/hal/AdcSensor.cpp
    src/hal/GpioFan.cpp
    src/hal/UartLogger.cpp
    src/domain/TemperatureProcessor.cpp
    src/app/TemperatureController.cpp
)
target_include_directories(app PRIVATE
    src/hal
    src/domain
    src/app
)
```

## prj.conf
```kconfig
CONFIG_CPP=y
CONFIG_STD_CPP17=y
CONFIG_NEWLIB_LIBC=y
CONFIG_LIB_CPLUSPLUS=y
```

## src/main.cpp
```c
#include <zephyr.h>
#include "AdcSensor.hpp"
#include "GpioFan.hpp"
#include "UartLogger.hpp"
#include "TemperatureController.hpp"

extern "C" void main(void) {
    static AdcDriver adc;
    static GpioDriver gpio;
    static UartDriver uart;

    AdcSensor sensor(adc);
    GpioFan fan(gpio);
    UartLogger logger(uart);

    TemperatureController controller(sensor, fan, logger);

    while (true) {
        controller.regulate();
        k_sleep(K_SECONDS(1));
    }
}
```
